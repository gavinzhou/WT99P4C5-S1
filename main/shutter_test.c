/*
 * SPDX-FileCopyrightText: 2026 PacPort Inc.
 * SPDX-License-Identifier: CC0-1.0
 *
 * Spatial Shutter self-test — see shutter_test.h.
 */

#include "shutter_test.h"

#include <math.h>
#include <string.h>

#include "esp_log.h"
#include "esp_heap_caps.h"
#include "esp_timer.h"

#include "shutter.h"

/* Header generated by hyperfi/tests/gen_shutter_fixtures.py. If this file is
 * missing, run:
 *    cd hyperfi && python3 tests/gen_shutter_fixtures.py \
 *        --out ../WT99P4C5-S1/main/shutter_fixtures.h
 * __has_include allows a clean "no fixtures → test no-op" fallback so builds
 * without fixtures still succeed. */
#if __has_include("shutter_fixtures.h")
#  include "shutter_fixtures.h"
#  define SHUTTER_HAS_FIXTURES 1
#endif

static const char *TAG = "shutter_test";

#ifdef SHUTTER_HAS_FIXTURES

/* Rel error passing threshold — ADR-023 M3.1 criterion. */
#define SHUTTER_REL_ERR_THRESHOLD  1e-3f

/* Compare two complex-interleaved arrays; return (max_abs, max_rel) errors. */
static void compare_cplx(
    const float *got,
    const float *expected,
    int n_cplx,          /* number of complex values (= half of float count) */
    float *out_max_abs,
    float *out_max_rel)
{
    float max_abs = 0.0f;
    float max_rel = 0.0f;
    for (int i = 0; i < 2 * n_cplx; i++) {
        float diff = fabsf(got[i] - expected[i]);
        if (diff > max_abs) max_abs = diff;
        float denom = fabsf(expected[i]);
        /* Only compute relative error where the expected magnitude is
         * non-negligible (avoids divide-by-zero amplification for values
         * that should be ~0). Absolute threshold catches small values. */
        if (denom > 1e-4f) {
            float rel = diff / denom;
            if (rel > max_rel) max_rel = rel;
        }
    }
    *out_max_abs = max_abs;
    *out_max_rel = max_rel;
}

esp_err_t shutter_run_self_test(void)
{
    ESP_LOGI(TAG, "=== Spatial Shutter Self-Test (ADR-023 M3.1) ===");
    ESP_LOGI(TAG, "Fixtures: %d, N_sc=%d, fft_size=%d, rel_err threshold=%.0e",
             SHUTTER_FIXTURE_COUNT,
             SHUTTER_FIXTURE_N_SC,
             SHUTTER_FIXTURE_FFT_SIZE,
             SHUTTER_REL_ERR_THRESHOLD);

    /* Configure shutter to match fixture dimensions */
    shutter_config_t cfg = SHUTTER_CONFIG_DEFAULT();
    cfg.n_subcarriers = SHUTTER_FIXTURE_N_SC;
    cfg.fft_size      = SHUTTER_FIXTURE_FFT_SIZE;

    shutter_state_t *state = NULL;
    esp_err_t err = shutter_init(&state, &cfg);
    if (err != ESP_OK) {
        ESP_LOGE(TAG, "shutter_init failed: %d", err);
        return err;
    }

    /* Output buffer — per-fixture, reused */
    float *out_H = heap_caps_aligned_alloc(
        16,
        (size_t)SHUTTER_FIXTURE_N_SC * 2 * sizeof(float),
        MALLOC_CAP_SPIRAM | MALLOC_CAP_8BIT);
    if (!out_H) {
        ESP_LOGE(TAG, "out_H alloc failed");
        shutter_deinit(state);
        return ESP_ERR_NO_MEM;
    }

    int pass_count = 0;
    int fail_count = 0;
    int64_t total_us = 0;

    for (int i = 0; i < SHUTTER_FIXTURE_COUNT; i++) {
        const shutter_fixture_t *fx = &shutter_fixtures[i];

        /* Fresh state for each fixture: clear any baseline + frame_count */
        shutter_clear_baseline(state);

        shutter_metadata_t meta = {0};
        int64_t t0 = esp_timer_get_time();
        err = shutter_process(state, fx->H_freq_in, SHUTTER_FRAME_HT20, out_H, &meta);
        int64_t dt = esp_timer_get_time() - t0;
        total_us += dt;

        if (err != ESP_OK) {
            ESP_LOGE(TAG, "[%s] shutter_process failed: %d", fx->name, err);
            fail_count++;
            continue;
        }

        /* Compare H_filtered */
        float max_abs = 0.0f, max_rel = 0.0f;
        compare_cplx(out_H, fx->H_filtered_expected, SHUTTER_FIXTURE_N_SC,
                     &max_abs, &max_rel);

        /* Compare scalar metadata */
        bool gate_ok = (meta.gate_idx == fx->gate_idx_expected);
        float ipr_err  = fabsf(meta.indoor_power_ratio - fx->indoor_power_ratio_expected);
        float snr_err  = fabsf(meta.snr_improvement_db - fx->snr_improvement_db_expected);
        bool ipr_ok = (ipr_err < 1e-3f);
        bool snr_ok = (snr_err < 0.5f);   /* dB, relaxed since log of near-zero amplifies */

        bool pass = (max_rel < SHUTTER_REL_ERR_THRESHOLD) && gate_ok && ipr_ok && snr_ok;
        if (pass) pass_count++;
        else      fail_count++;

        ESP_LOGI(TAG, "[%-4s] %-26s  %lldus  H:max_rel=%.2e abs=%.2e  gate=%d/%d  ipr=%.4f/%.4f  snr=%+5.1f/%+5.1f",
                 pass ? "PASS" : "FAIL",
                 fx->name,
                 dt,
                 max_rel, max_abs,
                 meta.gate_idx, fx->gate_idx_expected,
                 meta.indoor_power_ratio, fx->indoor_power_ratio_expected,
                 meta.snr_improvement_db, fx->snr_improvement_db_expected);

        if (!pass) {
            if (!gate_ok) ESP_LOGW(TAG, "    gate_idx mismatch");
            if (!ipr_ok)  ESP_LOGW(TAG, "    indoor_power_ratio err=%.4f (> 1e-3)", ipr_err);
            if (!snr_ok)  ESP_LOGW(TAG, "    snr_improvement_db err=%.2f dB", snr_err);
            if (max_rel >= SHUTTER_REL_ERR_THRESHOLD)
                ESP_LOGW(TAG, "    H_filtered rel_err=%.2e (> %.0e)",
                         max_rel, SHUTTER_REL_ERR_THRESHOLD);
        }
    }

    float avg_us = (float)total_us / (float)SHUTTER_FIXTURE_COUNT;
    ESP_LOGI(TAG, "=== Self-Test: %d/%d PASS === avg_per_frame=%.1fus (V9 predicted 138us)",
             pass_count, SHUTTER_FIXTURE_COUNT, avg_us);

    heap_caps_free(out_H);
    shutter_deinit(state);

    return (fail_count == 0) ? ESP_OK : ESP_FAIL;
}

#else  /* !SHUTTER_HAS_FIXTURES */

esp_err_t shutter_run_self_test(void)
{
    ESP_LOGW(TAG, "Self-test skipped: shutter_fixtures.h not generated.");
    ESP_LOGW(TAG, "Run: cd hyperfi && python3 tests/gen_shutter_fixtures.py "
                 "--out ../WT99P4C5-S1/main/shutter_fixtures.h");
    return ESP_ERR_NOT_FOUND;
}

#endif  /* SHUTTER_HAS_FIXTURES */
